## br2-external/package/nemu-exec/Config.in
```kconfig
config BR2_PACKAGE_NEMU_EXEC
	bool "nemu-trap"
	depends on BR2_RISCV_ISA_RVI
	help
	  NEMU workload shim.

	  https://github.com/scratch-er/nemu-workloads
```

## br2-external/package/nemu-halt/Config.in
```kconfig
config BR2_PACKAGE_NEMU_HALT
	bool "nemu-halt"
	depends on BR2_RISCV_ISA_RVI
	help
	  A program that stops NEMU.

	  https://github.com/scratch-er/nemu-workloads
```

## br2-external/package/nemu-trap/Config.in
```kconfig
config BR2_PACKAGE_NEMU_TRAP
	bool "nemu-trap"
	depends on BR2_RISCV_ISA_RVI
	help
	  A program that sends debug signal NEMU.

	  https://github.com/scratch-er/nemu-workloads
```
